## base_external/package/aesd-chardriver/Config.in
```kconfig
config BR2_PACKAGE_AESD_CHARDRIVER
	bool "aesd-chardriver"
	help
	  aesd chardriver implementation
```

## base_external/package/ldd/Config.in
```kconfig
config BR2_PACKAGE_LDD
	bool "ldd"
	help
	  Incorporates the kernel image's defective and scull modules.
	  Implemented to comprehend package builds and external buildroot trees.
```
